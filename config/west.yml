## config/west.yml
```yaml
manifest:
  remotes:
    - name: zmkfirmware
      url-base: https://github.com/zmkfirmware

    - name: 280Zo
      url-base: https://github.com/280Zo

    - name: prospector
      url-base: https://github.com/t-ogura

  projects:
    - name: zmk
      remote: zmkfirmware
      # revision: v0.3-branch
      revision: main
      import: app/west.yml

    - name: zmk-pmw3610-driver
      remote: 280Zo
      revision: main

    - name: prospector-zmk-module
      remote: prospector
      revision: v2.1.0  # Use v2.1.0 for ZMK >  ≤0.3 (Zephyr 3.x)
      path: modules/prospector-zmk-module

  self:
    path: config
```
